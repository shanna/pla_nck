## config/boards/shields/pla_nck/Kconfig.defconfig
```kconfig
# Copyright (c) 2020 The ZMK Contributors
# SPDX-License-Identifier: MIT

if SHIELD_PLA_NCK_LEFT

config ZMK_KEYBOARD_NAME
	default "PLA_NCK"

config ZMK_SPLIT_BLE_ROLE_CENTRAL
	default y

endif

if SHIELD_PLA_NCK_LEFT || SHIELD_PLA_NCK_RIGHT

config ZMK_SPLIT
    default y

endif
```

## config/boards/shields/pla_nck/Kconfig.shield
```kconfig
# Copyright (c) 2020 The ZMK Contributors
# SPDX-License-Identifier: MIT

config SHIELD_PLA_NCK_LEFT
	def_bool $(shields_list_contains,pla_nck_left)

config SHIELD_PLA_NCK_RIGHT
	def_bool $(shields_list_contains,pla_nck_right)
```
